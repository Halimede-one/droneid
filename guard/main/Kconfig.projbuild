## guard/main/Kconfig.projbuild
```kconfig
menu "DroneID independent UART guard"
    config GUARD_SYSTEM_ID
        int "Vehicle system ID"
        range 1 252
        default 1
    config GUARD_SENSOR_COMPONENT
        int "Radio sensor component ID"
        range 1 252
        default 242
    config GUARD_COMPONENT
        int "Guard component ID (distinct from sensor and controller)"
        range 1 252
        default 243
    config GUARD_FC_COMPONENT
        int "Controller component ID"
        range 1 252
        default 1
    config GUARD_TARGET_SYSTEM
        int "Base-station system ID (must differ from vehicle; 253/254 forbidden)"
        range 1 255
        default 255
    config GUARD_TARGET_COMPONENT
        int "Base-station component ID"
        range 1 252
        default 190
endmenu
```

## guard/sdkconfig.defaults
```kconfig
CONFIG_ESPTOOLPY_FLASHSIZE_4MB=y
CONFIG_PARTITION_TABLE_CUSTOM=y
CONFIG_PARTITION_TABLE_CUSTOM_FILENAME="partitions.csv"
CONFIG_ESP_CONSOLE_USB_SERIAL_JTAG=y
CONFIG_ESP_CONSOLE_SECONDARY_NONE=y
CONFIG_LOG_DEFAULT_LEVEL_NONE=y
CONFIG_BOOTLOADER_LOG_LEVEL_NONE=y
CONFIG_COMPILER_STACK_CHECK_MODE_ALL=y
CONFIG_ESP_MAIN_TASK_STACK_SIZE=8192
CONFIG_BT_ENABLED=n
CONFIG_ESP_WIFI_ENABLED=n
```
